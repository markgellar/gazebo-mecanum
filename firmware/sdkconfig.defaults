## firmware/sdkconfig.defaults
```kconfig
CONFIG_FREERTOS_HZ=1000
CONFIG_AUTOSTART_ARDUINO=y
CONFIG_MICRO_ROS_AGENT_IP="10.0.0.154"
CONFIG_MICRO_ROS_AGENT_PORT="8888"
CONFIG_MICRO_ROS_WIFI_SSID="Pomegranates"
CONFIG_MICRO_ROS_WIFI_PASSWORD="YOUR_PASSWORD"
CONFIG_PARTITION_TABLE_CUSTOM=y
CONFIG_PARTITION_TABLE_CUSTOM_FILENAME="partitions.csv"
CONFIG_ESP_MAIN_TASK_STACK_SIZE=16384
```
